## src/Kconfig
```kconfig
menu "Klatchian Mist"
	depends on ZB_ENABLED

config MIST_UI_LED_BRIGHTNESS
	int "RGB LED brightness"
	range 0 255
	default 8
	help
		Configure LED brightness.

config MIST_ZIGBEE_ROLE_ROUTER
	bool
	default y if ZB_ZCZR

menuconfig MIST_SUPPORT_OTA
	bool "Support OTA"
	default n
	help
		Support OTA (over the air) updates. These are slow and take a long time
		to complete. They're also defined in a restrictive way that expects you
		to have a Zigbee manufacturer ID (limited to 65535 values!) and wait for
		the device to pull updates from another Zigbee device/coordinator on the
		network. Updates will be marked valid automatically when a connection is
		established to a network.

if MIST_SUPPORT_OTA
	config MIST_OTA_MANUFACTURER_ID
		hex "Manufacturer ID"
		range 0x0000 0xfffe
		default 0
		help
			Configure Zigbee manufacturer ID for OTA updates.

	config MIST_OTA_IMAGE_TYPE_ID
		hex "Image Type ID"
		range 0x0000 0xfffe
		default 0
		help
			Configure image type ID (to uniquely identify this device model)
			for OTA updates.

	config MIST_OTA_FILE_VERSION_FROM_GIT_COMMIT
		bool "Use Git commit timestamp as OTA file version"
		default n
		help
			Configure the current file version (to identify which builds are
			newer) automatically using the timestamp of the current Git commit.

			This may go badly wrong while bisecting with older versions on a
			network with an upgrade server.

	config MIST_OTA_FILE_VERSION
		hex "File Version"
		range 0x00000000 0xffffffff
		default 0
		depends on !MIST_OTA_FILE_VERSION_FROM_GIT_COMMIT
		help
			Configure the current file version (to identify which builds are
			newer).
endif

endmenu
```
